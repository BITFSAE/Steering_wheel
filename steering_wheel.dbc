VERSION ""

NS_ :

BS_: 500000

BU_: VCU SteeringWheel

BO_ 1792 SlipLevel_0x700: 1 SteeringWheel
 SG_ SlipLevel : 0|8@1+ (1,0) [0|7] "" VCU

BO_ 1793 RecorderToggle_0x701: 1 SteeringWheel
 SG_ RecorderToggle : 0|1@1+ (1,0) [0|1] "" VCU

BO_ 1794 ErrorClear_0x702: 1 SteeringWheel
 SG_ ErrorClearActive : 0|1@1+ (1,0) [0|1] "" VCU

CM_ BO_ 1792 "Slip level — event-driven, sent only when slip level changes";
CM_ SG_ 1792 SlipLevel "PA1 ADC potentiometer quantized: 0..7 = 8 slip levels";

CM_ BO_ 1793 "Recorder/camera toggle — sent on PB12 rising edge";
CM_ SG_ 1793 RecorderToggle "PB12 rising edge: bit0=1 = toggle recorder/camera state";

CM_ BO_ 1794 "Error clear — sent on PB13 rising edge";
CM_ SG_ 1794 ErrorClearActive "PB13 rising edge: bit0=1 = clear error";

VAL_ 1792 SlipLevel 0 "Level_0" 1 "Level_1" 2 "Level_2" 3 "Level_3" 4 "Level_4" 5 "Level_5" 6 "Level_6" 7 "Level_7";

VAL_ 1793 RecorderToggle 1 "Toggle";

VAL_ 1794 ErrorClearActive 1 "ErrorClear";

BA_DEF_ "BusType" STRING;
BA_DEF_DEF_ "BusType" "CAN";
